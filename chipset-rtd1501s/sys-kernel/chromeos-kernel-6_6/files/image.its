## chipset-rtd1501s/sys-kernel/chromeos-kernel-6_6/files/image.its
```
/dts-v1/;

/ {
    description = "U-Boot fitImage for rtd1625 aarch64 kernel";
    #address-cells = <1>;

    images {
        kernel-1 {
            description = "Linux Kernel";
            data = /incbin/("BOOT_IMG");
            type = "kernel";
            arch = "arm64";
            os = "linux";
            compression = "lzma";
            load = <0x01200000>; /* ALIGN(0x01008000, SZ_2M); */
            entry = <0x01200000>;
            hash-1 {
                algo = "sha256";
            };
        };
        fdt-1 {
            description = "Normal DTB";
            data = /incbin/("BOARD_DTB");
            type = "flat_dt";
            arch = "arm64";
            compression = "none";
            load = <0x03000000>;
            hash-1 {
                algo = "sha256";
            };
        };
    };
    configurations {
        default = "normal";
        normal {
            description = "Normal boot with FDT blob";
            kernel = "kernel-1";
            fdt = "fdt-1";
            signature {
                algo = "sha256,rsa2048";
                key-name-hint = "dev";
                sign-images = "fdt", "kernel";
            };
        };
    };
};
```

## chipset-rtd1619b/sys-boot/realtek-uboot-script/files/boot-B.its
```
/dts-v1/;

/ {
  description = "FIT image to the source command";
  #address-cells = <1>;
  images {
    default = "script-1";

    script-1 {
      description = "Bootscript";
      data = /incbin/("boot-B.cmd");
      type = "script";
      compression = "none";
      hash-1 {
        algo = "sha256";
      };
    };
  };

  configurations {
    default = "conf-1";
    conf-1 {
      script = "script-1";
      signature {
        algo = "sha256,rsa2048";
        key-name-hint = "dev";
        sign-images = "script";
      };
    };
  };
};
```

## chipset-rtd1619b/sys-boot/realtek-uboot/files/src/board/realtek/rtd1619b_spi.its
```
/dts-v1/;

/ {
    description = "U-Boot proper and firmware blobs, loaded by U-Boot SPL";
    #address-cells = <1>;

    images {
        uboot {
            description = "U-Boot (64-bit)";
            data = /incbin/("u-boot-nodtb.bin");
            type = "firmware";
            os = "u-boot";
            arch = "arm64";
            compression = "none";
            load = <0x03F60000>;
            entry = <0x03F60000>;
            hash-1 {
                algo = "sha256";
            };
        };
        fdt {
            description = "U-Boot DTB";
            data = /incbin/("dts/dt.dtb");
            type = "flat_dt";
            arch = "arm64";
            compression = "none";
            load = <0x03000000>;
            hash-1 {
                algo = "sha256";
            };
        };
        pcpu_cert {
            description = "Certificate for PCPU FW";
            data = /incbin/("./source/fw/PCPU_Certificate_final.bin");
            type = "firmware";
            arch = "arm64";
            compression = "none";
            load = <0x01500000>;
            hash-1 {
                algo = "sha256";
            };
        };
        pcpu {
            description = "PCPU FW";
            data = /incbin/("./source/fw/PCPU_Code_Area_final.bin");
            type = "firmware";
            arch = "arm64";
            compression = "none";
            load = <0x01500400>;
            hash-1 {
                algo = "sha256";
            };
        };
    };

    configurations {
        default = "normal";

        normal {
            description = "Boot to U-Boot proper with FWs";
            firmware = "uboot";
            fdt = "fdt";
            loadables = "pcpu_cert", "pcpu";
        };
    };
};
```
